## config/boards/shields/Zhi40/Kconfig.defconfig
```kconfig
# Copyright (c) 2021 The ZMK Contributors
# SPDX-License-Identifier: MIT

if SHIELD_Zhi40

config ZMK_KEYBOARD_NAME
    default "Zhi40"

endif
```

## config/boards/shields/Zhi40/Kconfig.shields
```kconfig
# Copyright (c) 2021 The ZMK Contributors
# SPDX-License-Identifier: MIT

config SHIELD_Zhi40
    def_bool $(shields_list_contains,Zhi40)
```
